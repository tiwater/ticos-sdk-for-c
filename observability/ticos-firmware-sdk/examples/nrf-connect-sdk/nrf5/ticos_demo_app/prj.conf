## sample.yaml
```
sample:
  description: Ticos SDK example integration built on top of the Zephyr FS
    shell sample app, with the nRF Connect SDK
  name: Ticos Demo App
```

## west.yml
```
manifest:
  remotes:
    - name: nrf-connect-sdk
      url-base: https://github.com/nrfconnect
  projects:
    - name: nrf
      url: https://github.com/nrfconnect/sdk-nrf
      revision: v2.0.2
      import: true

    # Adding the ticos-firmware-sdk module here overrides the version the nRF
    # Connect SDK would normally import above
    - name: ticos-firmware-sdk
      url: https://github.com/ticos/ticos-firmware-sdk
      path: modules/lib/ticos-firmware-sdk
      revision: master
  self:
    path: ticos_demo_app
```

## prj.conf
```kconfig
CONFIG_HEAP_MEM_POOL_SIZE=16384
CONFIG_MAIN_STACK_SIZE=4096

CONFIG_SHELL=y
CONFIG_SHELL_LOG_LEVEL_INF=y

# hwinfo is used to get a unique device id from the chip id
CONFIG_HWINFO=y

# Enable Ticos
CONFIG_TICOS=y

# Use internal flash to store the coredump
CONFIG_TICOS_NCS_INTERNAL_FLASH_BACKED_COREDUMP=y
CONFIG_PM_PARTITION_SIZE_TICOS_STORAGE=0x20000

# set a dummy project key; this setting is required by the nrf-connect
# integration, but it is unused in a non-HTTP application
CONFIG_TICOS_NCS_PROJECT_KEY="xxxxxxxxxxxxxxxxxxxxxxxxxxxxxxxx"

# Set device information fields
CONFIG_TICOS_NCS_DEVICE_ID_RUNTIME=y
CONFIG_TICOS_NCS_HW_VERSION="a"
CONFIG_TICOS_NCS_FW_TYPE="nrf52_example"
CONFIG_TICOS_NCS_FW_VERSION_STATIC=y
CONFIG_TICOS_NCS_FW_VERSION="0.0.1"

# Enable and configure logging
CONFIG_LOG=y
CONFIG_LOG_BACKEND_UART=y
# Disable the shell log backend. Rely on the configured backend instead (RTT,
# UART, etc.)
CONFIG_SHELL_LOG_BACKEND=n
# Immediate logging is more performant at the expense of the rest of the system.
# Default is deferred to the logging thread.
CONFIG_LOG_MODE_IMMEDIATE=y
# Enable DBG log level
CONFIG_TICOS_LOG_LEVEL_DBG=y

# Enable capture of recent logs as part of a coredump
CONFIG_TICOS_LOGGING_ENABLE=y

# Enable Flash and Bootloader components for for flash-backed coredump storage
CONFIG_BOOTLOADER_MCUBOOT=y
CONFIG_MCUBOOT_IMG_MANAGER=y
CONFIG_IMG_MANAGER=y
CONFIG_FLASH=y

CONFIG_WATCHDOG=y
```

## src/main.c
```c
//! @file
//!
//! Copyright (c) Ticos, Inc.
//! See License.txt for details
//!
//! Example console main

#include <drivers/hwinfo.h>
#include <logging/log.h>
#include <ticos/components.h>
#include <ticos_ncs.h>
#include <stdio.h>

#include "ticos/ports/watchdog.h"

LOG_MODULE_REGISTER(main, LOG_LEVEL_INF);

//! wrapper to enclose logic around log_strdup
char *prv_conditional_log_strdup(char *str) {
#if !TICOS_ZEPHYR_VERSION_GT(3, 1)
  #if defined(CONFIG_LOG) && !defined(CONFIG_LOG2)
  // Before zephyr 3.1, LOG was a different option from LOG2 and required
  // manually duplicating string argument values. Only required if CONFIG_LOG is
  // in use.
  return log_strdup(str);
  #endif
#endif

  return str;
}
static void prv_set_device_id(void) {
  uint8_t dev_id[16] = {0};
  char dev_id_str[sizeof(dev_id) * 2 + 1];
  char *dev_str = "UNKNOWN";

  // Obtain the device id
  ssize_t length = hwinfo_get_device_id(dev_id, sizeof(dev_id));

  // If this fails for some reason, use a fixed ID instead
  if (length <= 0) {
    dev_str = CONFIG_SOC_SERIES "-test";
    length = strlen(dev_str);
  } else {
    // Render the obtained serial number in hexadecimal representation
    for (size_t i = 0; i < length; i++) {
      (void)snprintf(&dev_id_str[i * 2], sizeof(dev_id_str), "%02x", dev_id[i]);
    }
    dev_str = dev_id_str;
  }

  LOG_INF("Device ID: %s", prv_conditional_log_strdup(dev_str));

  ticos_ncs_device_id_set(dev_str, length * 2);
}

#define WD_FEED_THREAD_STACK_SIZE 500
// set priority to lowest application thread; shell_uart, where the 'tcs test
// hang' command runs from, uses the same priority by default, so this should
// not preempt it and correctly trip the watchdog
#if CONFIG_SHELL_THREAD_PRIORITY_OVERRIDE
  #error "Watchdog feed thread priority must be lower than shell thread priority"
#endif
#define WD_FEED_THREAD_PRIORITY K_LOWEST_APPLICATION_THREAD_PRIO

static void prv_wd_feed_thread_function(void *arg0, void *arg1, void *arg2) {
  ARG_UNUSED(arg0);
  ARG_UNUSED(arg1);
  ARG_UNUSED(arg2);

  while (1) {
    ticos_software_watchdog_feed();
    k_sleep(K_SECONDS(1));
  }
}
K_THREAD_DEFINE(wd_feed_thread, WD_FEED_THREAD_STACK_SIZE, prv_wd_feed_thread_function, NULL, NULL,
                NULL, WD_FEED_THREAD_PRIORITY, 0, 0);

static void prv_start_watchdog_feed_thread(void) {
  LOG_INF("starting watchdog feed thread 🐶");
  ticos_software_watchdog_enable();
  k_thread_name_set(wd_feed_thread, "wd_feed_thread");
  k_thread_start(wd_feed_thread);
}

void main(void) {
  LOG_INF("Booting Ticos sample app!");

  // Set the device id based on the hardware UID
  prv_set_device_id();

  ticos_device_info_dump();

  prv_start_watchdog_feed_thread();
}
```
