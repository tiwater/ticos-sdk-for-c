## CMakeLists.txt
```
# Zephyr Example Application

cmake_minimum_required(VERSION 3.20.0)

find_package(Zephyr REQUIRED HINTS $ENV{ZEPHYR_BASE})

target_sources(app PRIVATE src/main.c)
zephyr_include_directories(config)
project(qemu-app LANGUAGES C VERSION 1.0.0)

# Generate a git hash that's used as part of the software_version, eg
# 1.0.0+12345678
EXECUTE_PROCESS(
  WORKING_DIRECTORY ${CMAKE_CURRENT_SOURCE_DIR}
  COMMAND git rev-parse --short HEAD
  RESULT_VARIABLE commit_sha1
  OUTPUT_VARIABLE ZEPHYR_TICOS_EXAMPLE_GIT_SHA1
  OUTPUT_STRIP_TRAILING_WHITESPACE
  COMMAND_ERROR_IS_FATAL ANY
)

zephyr_compile_definitions(
  ZEPHYR_TICOS_EXAMPLE_GIT_SHA1=\"${ZEPHYR_TICOS_EXAMPLE_GIT_SHA1}\"
)
```

## Kconfig
```
# Application Kconfig file
#
# This is loaded when building this directory with west.
menu "Ticos Example Application Configuration"

config ZEPHYR_TICOS_EXAMPLE_THREAD_TOGGLE
    bool "Example thread create + abort toggling every 10 seconds"
    default n
    help
      Enables creating and aborting an example thread every 10 seconds in the
      example app

config ZEPHYR_TICOS_EXAMPLE_MEMORY_METRICS
    bool "Use metrics to monitor memory usage in the example app"
    default y
    depends on TICOS

endmenu

source "Kconfig.zephyr"
```

## west.yml
```
# West manifest for Ticos Example Application

manifest:
  self:
    path: qemu-app

  remotes:
    - name: zephyrproject-rtos
      url-base: https://github.com/zephyrproject-rtos
    - name: ticos
      url-base: https://github.com/ticos

  projects:
    - name: zephyr
      remote: zephyrproject-rtos
      revision: zephyr-v3.2.0
      import: true

    - name: ticos-firmware-sdk
      path: modules/lib/ticos-firmware-sdk
      remote: ticos
      # Note: normally this would be pinned to a specific SDK tag instead of
      # master
      revision: master
```

## prj.conf
```kconfig
# This file contains selected Kconfig options for the application.

# Ticos configuration
CONFIG_TICOS=y

# Enable UART console and shell for testing ticos
CONFIG_CONSOLE=y
CONFIG_UART_CONSOLE=y
CONFIG_SHELL=y

# This makes the qemu guest run closer to real time instead of super fast
CONFIG_QEMU_ICOUNT=n

CONFIG_LOG=y
# LOG v2 option, only for pre zephyr-v3.1.0
# CONFIG_LOG2_MODE_DEFERRED=y
CONFIG_LOG_BACKEND_UART=y
# Disable shell log output to prevent duplicate logs, since UART backend is
# already enabled. Shell log backend enables later than UART backend, and won't
# show the boot splash messages, so it's simpler to just enable the UART
# backend. Note that the RTT backend is enabled by default- that's ok, and could
# be useful if the board doesn't have a UART available.
CONFIG_SHELL_LOG_BACKEND=n

CONFIG_SYS_HEAP_RUNTIME_STATS=y
CONFIG_HEAP_MEM_POOL_SIZE=4096
CONFIG_MAIN_STACK_SIZE=4096
```

## src/main.c
```c
//! @file
//!
//! Copyright (c) Ticos, Inc.
//! See License.txt for details
//!
//! Example app main

#include <device.h>
#include <devicetree.h>
#include <drivers/gpio.h>
#include <shell/shell.h>
#include <logging/log.h>
#include <zephyr.h>

#include "ticos/components.h"

LOG_MODULE_REGISTER(main, LOG_LEVEL_INF);

#if CONFIG_ZEPHYR_TICOS_EXAMPLE_MEMORY_METRICS
//! Size of memory to allocate on main stack
//! This requires a larger allocation due to the method used to measure stack usage
#define STACK_ALLOCATION_SIZE (CONFIG_MAIN_STACK_SIZE >> 2)
//! Size of memory to allocate on system heap
#define HEAP_ALLOCATION_SIZE (CONFIG_HEAP_MEM_POOL_SIZE >> 3)
//! Value to sleep for observing metrics changes
#define METRICS_OBSERVE_PERIOD TICOS_METRICS_HEARTBEAT_INTERVAL_SECS

//! Array of heap pointers
static void *heap_ptrs[4] = {NULL};

//! Keep a reference to the main thread for stack info
static struct k_thread *s_main_thread = NULL;
#endif  // CONFIG_ZEPHYR_TICOS_EXAMPLE_MEMORY_METRICS

// Blink code taken from the zephyr/samples/basic/blinky example.
static void blink_forever(void) {
#if CONFIG_QEMU_TARGET
  k_sleep(K_FOREVER);
#else
  /* 1000 msec = 1 sec */
  #define SLEEP_TIME_MS 1000

  /* The devicetree node identifier for the "led0" alias. */
  #define LED0_NODE DT_ALIAS(led0)

  static const struct gpio_dt_spec led = GPIO_DT_SPEC_GET(LED0_NODE, gpios);

  int ret = gpio_pin_configure_dt(&led, GPIO_OUTPUT_ACTIVE);
  if (ret < 0) {
    return;
  }

  while (1) {
    gpio_pin_toggle_dt(&led);
    k_msleep(SLEEP_TIME_MS);
  }
#endif  // CONFIG_QEMU_TARGET
}

void ticos_platform_get_device_info(sTicosDeviceInfo *info) {
  *info = (sTicosDeviceInfo){
    .device_serial = "DEMOSERIAL",
    .software_type = "zephyr-app",
    .software_version = "1.0.0+" ZEPHYR_TICOS_EXAMPLE_GIT_SHA1,
    .hardware_version = CONFIG_BOARD,
  };
}

#if CONFIG_ZEPHYR_TICOS_EXAMPLE_THREAD_TOGGLE
K_THREAD_STACK_DEFINE(test_thread_stack_area, 1024);
static struct k_thread test_thread;

static void prv_test_thread_function(void *arg0, void *arg1, void *arg2) {
  ARG_UNUSED(arg0);
  ARG_UNUSED(arg1);
  ARG_UNUSED(arg2);

  k_sleep(K_FOREVER);
}

static void prv_test_thread_work_handler(struct k_work *work) {
  ARG_UNUSED(work);

  static bool started = false;
  if (started) {
    LOG_INF("ending test_thread ❌");
    k_thread_abort(&test_thread);
    started = false;
  } else {
    LOG_INF("starting test_thread ✅");
    k_thread_create(&test_thread, test_thread_stack_area,
                    K_THREAD_STACK_SIZEOF(test_thread_stack_area), prv_test_thread_function, NULL,
                    NULL, NULL, 7, 0, K_FOREVER);
    k_thread_name_set(&test_thread, "test_thread");
    k_thread_start(&test_thread);
    started = true;
  }
}
K_WORK_DEFINE(s_test_thread_work, prv_test_thread_work_handler);

//! Timer handlers run from an ISR so we dispatch the heartbeat job to the
//! worker task
static void prv_test_thread_timer_expiry_handler(struct k_timer *dummy) {
  k_work_submit(&s_test_thread_work);
}
K_TIMER_DEFINE(s_test_thread_timer, prv_test_thread_timer_expiry_handler, NULL);

static void prv_init_test_thread_timer(void) {
  k_timer_start(&s_test_thread_timer, K_SECONDS(10), K_SECONDS(10));

  // fire one time right away
  k_work_submit(&s_test_thread_work);
}
#else
static void prv_init_test_thread_timer(void) {}
#endif  // CONFIG_ZEPHYR_TICOS_EXAMPLE_THREAD_TOGGLE

#if CONFIG_ZEPHYR_TICOS_EXAMPLE_MEMORY_METRICS

//! Helper function to collect metric value on main thread stack usage.
static void prv_collect_main_thread_stack_free(void) {
  if (s_main_thread == NULL) {
    return;
  }

  size_t unused = 0;
  int rc = k_thread_stack_space_get(s_main_thread, &unused);
  if (rc == 0) {
    rc = ticos_metrics_heartbeat_set_unsigned(TICOS_METRICS_KEY(MainStack_MinBytesFree), unused);
    if (rc) {
      LOG_ERR("Error[%d] setting MainStack_MinBytesFree", rc);
    }
  } else {
    LOG_ERR("Error getting thread stack usage[%d]", rc);
  }
}

//! Shell function to exercise example memory metrics
//!
//! This function demonstrates the change in stack and heap memory metrics
//! as memory is allocated and deallocated from these regions.
//!
//! @warning This code uses `ticos_metrics_heartbeat_debug_trigger` which is not intended
//! to be used in production code. This functions use here is solely to demonstrate the metrics
//! values changing. Production applications should rely on the heartbeat timer to trigger
//! collection
static int prv_run_example_memory_metrics(const struct shell *shell, size_t argc, char **argv) {
  ARG_UNUSED(shell);
  ARG_UNUSED(argc);
  ARG_UNUSED(argv);

  if (s_main_thread == NULL) {
    return 0;
  }

  // Next two loops demonstrate heap usage metric
  for (size_t i = 0; i < ARRAY_SIZE(heap_ptrs); i++) {
    heap_ptrs[i] = k_malloc(HEAP_ALLOCATION_SIZE);
  }

  // Collect data after allocation
  ticos_metrics_heartbeat_debug_trigger();

  for (size_t i = 0; i < ARRAY_SIZE(heap_ptrs); i++) {
    k_free(heap_ptrs[i]);
    heap_ptrs[i] = NULL;
  }

  // Collect data after deallocation
  ticos_metrics_heartbeat_debug_trigger();
  return 0;
}

SHELL_CMD_REGISTER(memory_metrics, NULL, "Collects runtime memory metrics from application", prv_run_example_memory_metrics);

// Override function to collect the app metric MainStack_MinBytesFree
// and print current metric values
void ticos_metrics_heartbeat_collect_data(void) {
  prv_collect_main_thread_stack_free();
  ticos_metrics_heartbeat_debug_print();
}

//! Helper function to demonstrate changes in stack metrics
static void prv_run_stack_metrics_example(void) {
  volatile uint8_t stack_array[STACK_ALLOCATION_SIZE];
  memset((uint8_t *)stack_array, 0, STACK_ALLOCATION_SIZE);
}
#endif  // CONFIG_ZEPHYR_TICOS_EXAMPLE_MEMORY_METRICS

void main(void) {
  LOG_INF("👋 Ticos Demo App! Board %s\n", CONFIG_BOARD);
  ticos_device_info_dump();

#if CONFIG_ZEPHYR_TICOS_EXAMPLE_MEMORY_METRICS
  s_main_thread = k_current_get();

  // @warning This code uses `ticos_metrics_heartbeat_debug_trigger` which is not intended
  // to be used in production code. This functions use here is solely to demonstrate the metrics
  // values changing. Production applications should rely on the heartbeat timer to trigger
  // collection

  // Collect a round of metrics to show initial stack usage
  ticos_metrics_heartbeat_debug_trigger();

  prv_run_stack_metrics_example();

  // Collect another round to show change in stack metrics
  ticos_metrics_heartbeat_debug_trigger();
#endif

  prv_init_test_thread_timer();

  blink_forever();
}
```
