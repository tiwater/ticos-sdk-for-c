## observability/ticos-firmware-sdk/ports/zephyr/Kconfig
```kconfig
config TICOS
        bool "TICOS Support"
        default n
        depends on CPU_CORTEX_M
        select RUNTIME_NMI
        select EXTRA_EXCEPTION_INFO
        select DEBUG_THREAD_INFO
        select LEGACY_INCLUDE_PATH
        help
          Enable Zephyr Integration with the Ticos SDK
          At the moment a port is only provided for Cortex-M based targets

if TICOS

config TICOS_CACHE_FAULT_REGS
        bool "TICOS Cache ARM fault registers"
        default y
        help
          Save a copy of the ARMv7's fault registers before Zephyr
          modifies them to provide a more accurate crash analysis
          in the Ticos Issues view.

config TICOS_USER_CONFIG_ENABLE
        bool "Enable user configuration of the Ticos SDK"
        default y
        help
          When enabled, a user must add the three Ticos
          configuration files to their port:
          ticos_platform_config.h
          ticos_metrics_heartbeat_config.def
          ticos_trace_reason_user_config.def

config TICOS_USER_CONFIG_SILENT_FAIL
        bool "Continue with build even if user configuration of Ticos SDK is missing"
        default y
        help
          When enabled, __has_include is used to conditionally include the three Ticos
          configuration files to a port if they exist instead of failing to compile if
          they do not:
          ticos_platform_config.h
          ticos_metrics_heartbeat_config.def
          ticos_trace_reason_user_config.def

config TICOS_COREDUMP_STORAGE_CUSTOM
        bool
        default n
        help
          Can be used by another Kconfig option to disable the RAM backed
          coredump implementation using select.

config TICOS_RAM_BACKED_COREDUMP
        bool "TICOS Ram Backed Coredump"
        default y if !TICOS_COREDUMP_STORAGE_CUSTOM
        depends on !TICOS_COREDUMP_STORAGE_CUSTOM
        help
          Save a minimal coredump in noinit RAM.

config TICOS_RAM_BACKED_COREDUMP_SIZE
        int "TICOS Ram Backed Coredump"
        default 8192
        depends on TICOS_RAM_BACKED_COREDUMP
        help
          The amount of RAM to allocate for saving coredumps

config TICOS_COREDUMP_COLLECT_DATA_REGIONS
        bool "Include data region in coredump"
        default y
        help
          When enabled, the data region will be captured as part
          of the coredump. If not enough space is available for all of
          the data, the coredump will be truncated.

config TICOS_COREDUMP_COLLECT_BSS_REGIONS
        bool "Include bss region in coredump"
        default n
        help
          When enabled, the bss region will be captured as part
          of the coredump. If not enough space is available for all of
          the data, the coredump will be truncated.

config TICOS_HEAP_STATS
        bool "Collect system heap stats with coredumps"
        default y
        help
          When enabled, system heap stats are captured as part of the coredump.
          The heap stats subsystem collects info on system heap
          allocation/deallocation (k_malloc/k_free).

config TICOS_SHELL
        bool "TICOS Shell"
        default y if SHELL
        depends on SHELL
        help
          CLI Utilities for interfacing with the Ticos SDK

config TICOS_HTTP_ENABLE
        bool "Enables support for using Ticos's HTTP APIs"
        default y if SOC_SERIES_NRF91X && TRUSTED_EXECUTION_NONSECURE
        help
          Enables support for querying the Ticos API for OTA updates
          and posting Ticos chunks

config TICOS_PLATFORM_LOG_FALLBACK_TO_PRINTK
        bool "Fallback to printk for platform logging"
        default y if ! LOG
        help
          When enabled, the platform logging implementation will fallback
          to printk if Zephyr LOG is disabled. This is useful for testing when
          Zephyr LOG is not enabled (eg due to code space limitations).

config TICOS_LOGGING_ENABLE
        bool "TICOS Zephyr backend logging Enable [EXPERIMENTAL]"
        default n
        select LOG
        select LOG_OUTPUT
        help
          Adds support for routing Zephyr logging calls to the Ticos
          logging backend.

if TICOS_LOGGING_ENABLE

config TICOS_LOGGING_RAM_SIZE
        int "Set the size of the Ticos logging storage buffer"
        default 512
        depends on TICOS_LOGGING_ENABLE
        help
          The Ticos logs will be stored in a static logging storage buffer
          defined in ticos_logging.c. Adjust this value to ensure enough
          room for a reasonalbe number of log entries.

endif # TICOS_LOGGING_ENABLE

config TICOS_ROOT_CERT_STORAGE
        bool "Ticos TLS root certificate storage enabled"
        default y if TICOS_HTTP_ENABLE
        help
          Enables TLS root certificate storage for Ticos data upload

choice TICOS_ROOT_CERT_STORAGE_CONTEXT
    bool "Implementation used to store Ticos Root certificates"
    default TICOS_ROOT_CERT_STORAGE_NRF9160_MODEM if SOC_SERIES_NRF91X && TRUSTED_EXECUTION_NONSECURE
    default TICOS_ROOT_CERT_STORAGE_TLS_CREDENTIAL_STORAGE
    depends on TICOS_ROOT_CERT_STORAGE

config TICOS_ROOT_CERT_STORAGE_NRF9160_MODEM
    bool "Uses the storage on the NRF9160 modem for storing root certificates"

config TICOS_ROOT_CERT_STORAGE_TLS_CREDENTIAL_STORAGE
    bool "Uses Zephyr's tls_credential_add() API for storing root certificates"

config TICOS_ROOT_CERT_STORAGE_CUSTOM
    bool "Provide a custom implementation of ticos_root_cert_storage_add()"

endchoice

if TICOS_HTTP_ENABLE

config TICOS_HTTP_MAX_POST_SIZE
        int "Set the Maximum HTTP Body Size Ticos will use in a POST request"
        default 0
        depends on TICOS_HTTP_ENABLE
        help
          Some network drivers have bugs which limit the maximum amount of
          data that can be sent in a single HTTP request. When the value is 0 (default),
          no size restriction on HTTP post size will be enforced. For a non-zero value,
          this will be the maximum body length of a posted check. This size is allocated
          on the stack posting the data.

config TICOS_HTTP_PERIODIC_UPLOAD
        bool "Enables a work job to periodically push new data to Ticos"
        default n
        help
          This implementation makes use of a k_timer_* and k_work_submit to schedule
          a background job that periodically checks to see if new Ticos data
          is available and pushes it to Ticos if so (via a HTTP POST).

choice TICOS_HTTP_PERIODIC_UPLOAD_CONTEXT
        prompt "Work queue implementation to use for periodic HTTP posting"
        depends on TICOS_HTTP_PERIODIC_UPLOAD
        default TICOS_HTTP_PERIODIC_UPLOAD_USE_SYSTEM_WORKQUEUE

config TICOS_HTTP_PERIODIC_UPLOAD_USE_SYSTEM_WORKQUEUE
        bool "Periodically push new data to Ticos from system workqueue"
        help
          When using this feature, make sure CONFIG_SYSTEM_WORKQUEUE_STACK_SIZE
          is set appropriately for the board's HTTP stack to not cause a stack overflow.

config TICOS_HTTP_PERIODIC_UPLOAD_USE_DEDICATED_WORKQUEUE
        bool "Periodically push new data to Ticos using a dedicated workqueue"
        help
          When using this feature, make sure CONFIG_TICOS_HTTP_DEDICATED_WORKQUEUE_STACK_SIZE
          is set appropriately for the board's HTTP stack to not cause a stack overflow. A dedicated
          workqueue over the system workqueue is beneficial if http requests for the network stack
          in use can block for a long time but comes at the cost of using extra RAM.

endchoice

config TICOS_HTTP_DEDICATED_WORKQUEUE_STACK_SIZE
        int "Stack size for dedicated http upload queue, in bytes"
        default 2048
        depends on TICOS_HTTP_PERIODIC_UPLOAD_USE_DEDICATED_WORKQUEUE

config TICOS_HTTP_PERIODIC_UPLOAD_INTERVAL_SECS
        int "Interval with which the periodic upload task should run"
        default 3600
        depends on TICOS_HTTP_PERIODIC_UPLOAD
        help
          The first check will run between [1, 1+TICOS_HTTP_PERIODIC_UPLOAD_INTERVAL_SECS]
          Subsequent checks will run at TICOS_HTTP_PERIODIC_UPLOAD_INTERVAL_SECS intervals.

config TICOS_HTTP_USES_MBEDTLS
        bool "Use mbedTLS for HTTP transport"
        default y if MBEDTLS
        help
          Configure Ticos HTTP for using mbedTLS- perform some sanity checks
          at compile time that it is configured correctly. Note that if MbedTLS
          is used for purposes other than securing the TCP/IP sockets, i.e. if
          TLS is offloaded to the underlying socket, this check is invalid, and
          should be explicitly set to 'n'.

endif # TICOS_HTTP_ENABLE

config TICOS_EVENT_STORAGE_SIZE
       int "Ticos Event Storage RAM Buffer Size"
       default 1024
       help
        The storage area used to batch ticos events before they are flushed
        to persistent storage or the Ticos Cloud.

config TICOS_COREDUMP_STACK_SIZE_TO_COLLECT
       int "Maximum amount of bytes to collect for task"
       default 256
       help
        The larger the size, the more stack frames Ticos can recover for tasks. The
        default setting typically allows for 4 or more frames to be recovered.

config TICOS_COREDUMP_MAX_TRACKED_TASKS
       int "Maximum amount of tasks to collect in a coredump"
       default 32
       help
        The maximum amount of tasks Ticos will store state for in a coredump.

config TICOS_REBOOT_REASON_GET_CUSTOM
       bool "Provide a custom implementation for recovering reboot information"
       default n
       help
        User of SDK must provide their own implementation of ticos_reboot_reason_get()
        when disabled

config TICOS_CLEAR_RESET_REG
       bool "Whether or not to clear bits in MCU reset reason register"
       default y
       help
        When disabled, the end user is responsible for clearing the reset register. (Bits
        generally persist across resets)

config TICOS_METRICS
       bool "Enable the ticos Metrics subsystem"
       default y

if TICOS_METRICS

config TICOS_METRICS_EXTRA_DEFS_FILE
       bool "Enable inclusion of additional metrics definition file"
       default n
       help
        Enables inclusion of an additional metric definition file,
        'ticos_metrics_heartbeat_extra.def'. This can be useful for third party
        libraries that want to include additional default metrics.

config TICOS_METRICS_TIMER_CUSTOM
       bool "Provide a custom implementation of Ticos Metric Deps"
       default n
       help
        By default the Ticos SDK makes use of Zephyrs k_timer_* to
        schedule the heartbeat timer and k_work_* to run the heartbeat callback
        work. This option can be used to disable that implementation in
        ports/zephyr/common/ticos_platform_metrics.c and allow for
        a custom implementation of ticos_platform_metrics_timer_boot() to be provided

config TICOS_METRICS_DEFAULT_SET_ENABLE
       bool "Enable collection of a default set of metrics by the Zephyr port"
       default y
       help
        By default the Ticos SDK will automatically capture heartbeat metrics
        to help track how the Zephyr RTOS is operating. For more details about the
        metrics collected, see ports/zephyr/config/ticos_metrics_heartbeat_zephyr_port_config.def
        When disabled, no default metrics will be collected.

endif # TICOS_METRICS

config TICOS_SOFTWARE_WATCHDOG_CUSTOM
       bool "Provide a custom implementation of Software Watchdog"
       default n
       help
        By default Ticos implements a software watchdog implementation. Users can call
        ticos_software_watchdog_enable() on boot and ticos_software_watchdog_feed()
        when they feed the hardware watchdog. When the software watchdog expires, Ticos
        will capture a coredump and then the system will be rebooted. This option can be used
        to disable the implementation in ports/zephyr/common/ticos_software_watchdog.c

config TICOS_SOFTWARE_WATCHDOG_TIMEOUT_SECS
       int "The time, in seconds, to configure the software watchdog expiration for"
       default 15

config TICOS_INIT_PRIORITY
        int "The priority of Ticos initialization on system start"
        default KERNEL_INIT_PRIORITY_DEFAULT
        help
         The SYS_INIT relative priority for Ticos initialization.

config TICOS_INIT_LEVEL_POST_KERNEL
        bool "Use POST_KERNEL init level for Ticos initialization"
        default n
        help
         Set the Ticos initialization SYS_INIT priority level to
         "POST_KERNEL". Default is "APPLICATION".

config TICOS_CATCH_ZEPHYR_ASSERT
        bool "Support backtrace through Zephyr __ASSERT() calls"
        default y
        help
         When enabled, Ticos will support proper backtraces when a Zephyr
         __ASSERT() trips. If disabled (i.e. user needs a custom implementation
         of assert_post_action()), backtraces will not be correctly captured
         from __ASSERT() macro call sites, unless assert_post_action() contains
         a TICOS_ASSERT() invocation.

module = TICOS
module-str = Ticos
source "subsys/logging/Kconfig.template.log_config"

rsource "ncs/Kconfig"

endif # TICOS
```

## observability/ticos-firmware-sdk/ports/zephyr/ncs/Kconfig
```kconfig
config TICOS_NRF_CONNECT_SDK
        bool "nRF Connect SDK extensions"
        default y if SOC_SERIES_NRF52X || ((SOC_SERIES_NRF91X || SOC_SERIES_NRF53X) && TRUSTED_EXECUTION_NONSECURE)
        select TICOS_REBOOT_REASON_GET_CUSTOM

if TICOS_NRF_CONNECT_SDK

config TICOS_FOTA
        bool "Enable Ticos FOTA Library"
        default n
        depends on TICOS_HTTP_ENABLE
        depends on FOTA_DOWNLOAD
        depends on DOWNLOAD_CLIENT
        help
          Adds support for using Ticoss Release Management infrastructure
          to retrieve binaries to install (https://ticos.io/release-mgmt). If an update
          is available, the binary will be downloaded and installed using the FOTA Download
          Client provided in the nRF Connect SDK.

          See https://ticos.io/nrf-fota-setup for more details

config TICOS_NRF_SHELL
        bool "Enable Ticos NRF Shell"
        default y if TICOS_SHELL
        depends on SHELL
        help
          CLI Utilities for interfacing with the nRF Connect SDK

if TICOS_FOTA

config TICOS_FOTA_CLI_CMD
        bool "Enable CLI command for triggering OTA updates"
        default y
        depends on TICOS_NRF_SHELL

config TICOS_FOTA_DOWNLOAD_CALLBACK_CUSTOM
        bool "Add custom handler for receiving OTA events"
        default n
        help
          By default, the Ticos SDK implements a stub for FOTA callback
          events. An end user can provide their own implementation by enabling
          this option and implementing ticos_fota_download_callback()

endif # TICOS_FOTA

endif # TICOS_NRF_CONNECT_SDK
```
