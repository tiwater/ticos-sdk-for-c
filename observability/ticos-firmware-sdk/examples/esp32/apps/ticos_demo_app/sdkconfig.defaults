## observability/ticos-firmware-sdk/examples/esp32/apps/ticos_demo_app/sdkconfig.defaults
```kconfig
# Reduce bootloader log verbosity
CONFIG_LOG_BOOTLOADER_LEVEL_WARN=y
CONFIG_LOG_BOOTLOADER_LEVEL=2

# Increase main and timer task stack sizes
CONFIG_SYSTEM_EVENT_TASK_STACK_SIZE=4096
CONFIG_MAIN_TASK_STACK_SIZE=7168
CONFIG_FREERTOS_TIMER_TASK_STACK_DEPTH=3072

#
# Core dump
#
CONFIG_ESP_COREDUMP_ENABLE_TO_FLASH=y
CONFIG_ESP_COREDUMP_ENABLE=y
CONFIG_ESP_COREDUMP_DATA_FORMAT_ELF=y
CONFIG_ESP32_ENABLE_COREDUMP_TO_FLASH=y

# Enable filesystem
CONFIG_PARTITION_TABLE_CUSTOM=y
CONFIG_PARTITION_TABLE_CUSTOM_FILENAME="partitions_example.csv"
CONFIG_PARTITION_TABLE_CUSTOM_APP_BIN_OFFSET=0x10000
CONFIG_PARTITION_TABLE_FILENAME="partitions_example.csv"
CONFIG_APP_OFFSET=0x10000

# Enable FreeRTOS stats formatting functions, needed for 'tasks' command
CONFIG_FREERTOS_USE_TRACE_FACILITY=y
CONFIG_FREERTOS_USE_STATS_FORMATTING_FUNCTIONS=y
CONFIG_FREERTOS_VTASKLIST_INCLUDE_COREID=y
CONFIG_FREERTOS_GENERATE_RUN_TIME_STATS=y
CONFIG_FREERTOS_RUN_TIME_STATS_USING_ESP_TIMER=y
# CONFIG_FREERTOS_RUN_TIME_STATS_USING_CPU_CLK is not set
CONFIG_ESPTOOLPY_FLASHSIZE_4MB=y

# Workaround for issue in ESP-IDF v4.2.2 python dependencies, see:
# https://github.com/espressif/esp-idf/issues/7631#issuecomment-934212224
# We only need the typical root certs, so this works for our app.
CONFIG_MBEDTLS_CERTIFICATE_BUNDLE_DEFAULT_CMN=y

CONFIG_TICOS_PROJECT_KEY="OPRJ424194lNzwzSKDKM"
```

## observability/ticos-firmware-sdk/ports/esp8266_sdk/ticos/Kconfig
```kconfig
menuconfig TICOS
   bool "Enable Ticos Integration"
   default y

if TICOS

    config TICOS_EVENT_COLLECTION_ENABLED
        bool "Enables collection of Ticos Events (Reboots, Traces, Heartbeats)"
        default y

    config TICOS_EVENT_HEARTBEATS_ENABLED
        bool "Enables collection of Ticos Heartbeats"
        depends on TICOS_EVENT_COLLECTION_ENABLED
        default y

    config TICOS_HEARTBEAT_TRACK_MAIN_STACK_HWM
       bool "Enables tracking of stack High Water mark for main (uiT) task"
       depends on TICOS_EVENT_COLLECTION_ENABLED
       default y

    config TICOS_HEARTBEAT_TRACK_HEAP_USAGE
       bool "Enables tracking of heap usage"
       depends on TICOS_EVENT_COLLECTION_ENABLED
       default y

    config TICOS_EVENT_STORAGE_RAM_SIZE
        int "The amount of RAM storage to reserve for Ticos Events"
        depends on TICOS_EVENT_COLLECTION_ENABLED
        default 512

    config TICOS_HTTP_CLIENT_BUFFER_SIZE
        int "The maximum amount of RAM to attempt to for a POST to the Ticos chunks API"
        default 4096

    config TICOS_CLI_ENABLED
        bool "Enables the Ticos debug CLI"
        default y
        help
            By default, Ticos will register CLI commands for easily exercising the SDK

    config TICOS_CLI_COREDUMP_STORAGE_TEST_CMD
        bool "Enables the coredump storage test CLI command"
        depends on TICOS_CLI_ENABLED
        default n
        help
            By default, Ticos will register CLI commands for easily exercising the SDK

   choice TICOS_COREDUMP_REGIONS
       prompt "Select the RAM regions to collect in a coredump"
       default TICOS_COREDUMP_REGIONS_ALL_RAM

       config TICOS_COREDUMP_REGIONS_ALL_RAM
          bool "Collect all of RAM as part of the coredump"

       config TICOS_COREDUMP_REGIONS_THREADS_ONLY
          bool "Only collect the RAM necessary to unwind FreeRTOS tasks"

      config TICOS_COREDUMP_REGIONS_CUSTOM
          bool "Provide custom implementation of ticos_platform_coredump_get_regions()"
   endchoice

   choice TICOS_COREDUMP_STORAGE
       prompt "Select location to save a coredump when a crash takes place"
       default TICOS_COREDUMP_STORAGE_FLASH

       config TICOS_COREDUMP_STORAGE_FLASH
          bool "Enables saving a coredump to flash storage (OTA slot)"
          help
           Provides a port which saves OTA updates in the next available OTA slot. This option
           requires that an ota slot exists in the projects partitions.csv file.

       config TICOS_COREDUMP_STORAGE_CUSTOM
          bool "User defined coredump storage region"
   endchoice

endif # TICOS
```

## observability/ticos-firmware-sdk/ports/esp_idf/ticos/Kconfig
```kconfig
menu "Ticos"

    config TICOS_PROJECT_KEY
        string "Ticos Project key"
        default ""
        help
          API Key needed to communicate to Ticos. Obtain key at https://ticos.io/project-key

    config TICOS_EVENT_STORAGE_RAM_SIZE
        int "The amount of RAM storage to reserve for Ticos Events"
        default 512

    config TICOS_LOG_STORAGE_RAM_SIZE
        int "The amount of RAM storage to allocate for log storage"
        default 1024
        help
            Logs stored in this buffer will be captured as part of a Ticos Coredump

    config TICOS_CLI_ENABLED
        bool "Enables the Ticos CLI"
        default y
        help
            By default, Ticos will register CLI commands for pushing data,
            dumping state of the SDK, and performing device updates.

    config TICOS_COREDUMP_USE_OTA_SLOT
        bool "Enables the use of an OTA slot for coredump storage"
        default n
        help
            By default, Ticos will attempt to use a coredump partition
            defined in a partitions*.csv file. If the device has already
            been shipped and the partition table cannot be modified, an
            OTA slot can be used instead.

    config TICOS_AUTOMATIC_INIT
        bool "Automatically initialize the SDK when the system is booted"
        default y
        help
            By default, Ticos will automatically initialize the SDK
            when the system is booted. This can be disabled if the user
            wants to initialize the SDK manually.

    config TICOS_HTTP_CLIENT_TIMEOUT_MS
        int "The HTTP client timeout in milliseconds"
        default 5000
        help
            The Ticos HTTP client timeout in milliseconds. This is the
            maximum amount of time the HTTP client will wait for a response from
            the server.
endmenu
```
